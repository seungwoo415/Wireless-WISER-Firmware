## prj.conf
```kconfig
# BLE
CONFIG_BT=y
CONFIG_BT_CENTRAL=y
CONFIG_BT_DEVICE_NAME="SPECT_MB"
CONFIG_BT_GATT_CLIENT=y
CONFIG_BT_SCAN=y
CONFIG_BT_SCAN_FILTER_ENABLE=y

# USB CDC ACM
CONFIG_USB_DEVICE_STACK=y
CONFIG_USB_DEVICE_PRODUCT="SPECT_MB"

CONFIG_USB_CDC_ACM=y
CONFIG_UART_LINE_CTRL=y
CONFIG_SERIAL=y
CONFIG_MAIN_STACK_SIZE=4096

# RTT 
CONFIG_LOG=y
CONFIG_USE_SEGGER_RTT=y
CONFIG_LOG_BACKEND_UART=n
CONFIG_LOG_BACKEND_RTT=y

CONFIG_REBOOT=y

CONFIG_BT_L2CAP_TX_MTU=64
CONFIG_BT_BUF_ACL_RX_SIZE=64
CONFIG_BT_BUF_ACL_TX_SIZE=64

CONFIG_BT_MAX_CONN=16
```

## src/main.c
```c
#include "final_mb.h" 
#include "ble.h"
#include "uart.h"

// logging
LOG_MODULE_REGISTER(final_mb, LOG_LEVEL_INF);

const struct bt_data ad[] = {
    BT_DATA_BYTES(BT_DATA_FLAGS, (BT_LE_AD_GENERAL | BT_LE_AD_NO_BREDR)),
    BT_DATA_BYTES(BT_DATA_UUID128_ALL, 
        BT_UUID_128_ENCODE(0x7231db4c, 0x67ed, 0x4bf7, 0xbe9f, 0x2b84348147ee)),
};

struct bt_le_scan_param scan_param = {
    .type     = BT_LE_SCAN_TYPE_ACTIVE,
    .options  = BT_LE_SCAN_OPT_NONE,
    .interval = BT_GAP_MS_TO_SCAN_INTERVAL(100), 
    .window   = BT_GAP_MS_TO_SCAN_WINDOW(50),
};

// UART device 
const struct device *uart = DEVICE_DT_GET(DT_NODELABEL(cdc_acm));

// process_command work handler 
struct command_work_t process_command_work;  

void process_command_work_handler(struct k_work *work_item)
{
    struct command_work_t *cmd = CONTAINER_OF(work_item, struct command_work_t, work);
    
    // Now we call process_command in a safe, low-priority thread context
    process_command(cmd->payload, uart); 
}

// initialize the motherboard
void initialize_mb(void) {
    int err;

    // Initialize Bluetooth
    err = bt_enable(NULL);
    if (err) {
        printk("Bluetooth init failed (err %d)\n", err);
        return;
    }

    // START SCANNING HERE
    err = bt_le_scan_start(&scan_param, device_found);
    if (err) {
        printk("Scanning failed to start (err %d)\n", err);
        return;
    }

    printk("Scanning started... Looking for Patch.\n");

    // initialize workers 
    k_work_init(&process_command_work.work, process_command_work_handler);
}

int main(void)
{       
        LOG_INF("START"); 

        initialize_mb(); 

        LOG_INF("initalize_mb...");
        initialize_uart(); 
        
        //LOG_INF("Waiting for DATAOUT handle...");
        k_msleep(5000); 

        // while (dataout_notify_handle == 0) {
        //     k_msleep(100); 
        // }
        // k_msleep(500);

        // if (current_conn && count_status_data_handle != 0) {

        //             k_msleep(1000); 
        // }
            
        // if (current_conn && al_data_handle != 0) {
        //         LOG_INF("Starting AL Read...");
        //         al_read(); 
        // } else {
        //         LOG_ERR("AL Read skipped: Not connected or handle not found");
        // }

        //k_msleep(1000);
 

        // k_msleep(200); 

        // write_sipo(0xF000, 0x0000, 0x0000, 0x0000, 
        //                 0x0000, 0x0000, 0x000F, 0x0000);
        
        //LOG_INF("while loop start"); 
        //count_status_read();
        while(1) { 
                k_sleep(K_FOREVER);
        }
        
        return 0; 
}
```

## src/ble.h
```c
/**
 * @file ble.h
 * @author Archie Lee
 * @brief Header file for BLE motherboard logic.
 * @details Defines the public structures and function prototypes for 
 * BLE connection, scanning, communication, and subscriptions.
 * @version 1.0
 * @date 2026-02-03
 */

#ifndef BLE_H
#define BLE_H

#ifdef __cplusplus
extern "C" {
#endif


/* --- UUID --- */
extern struct bt_uuid_128 spect_uuid;
extern struct bt_uuid_128 sipo_uuid;  
extern struct bt_uuid_128 dac_uuid;
extern struct bt_uuid_128 sramout_uuid;
extern struct bt_uuid_128 al_uuid;
extern struct bt_uuid_128 dl_uuid;
extern struct bt_uuid_128 dataout_uuid;
extern struct bt_uuid_128 syscmd_uuid;
extern struct bt_uuid_128 count_status_uuid;

/* --- Handle Variables --- */
struct patch_handles {
    uint16_t sipo_data;
    uint16_t sipo_notify;
    uint16_t dac_data;
    uint16_t dac_notify;
    uint16_t sramout_data;
    uint16_t sramout_notify;
    uint16_t al;
    uint16_t dl;
    uint16_t dataout_data;
    uint16_t dataout_notify;
    uint16_t syscmd;
    uint16_t count_status;
};

extern struct patch_handles patch_handle[MAX_PATCHES];

// extern uint16_t sipo_data_handle; 
// extern uint16_t sipo_notify_handle;
// extern uint16_t dac_data_handle; 
// extern uint16_t dac_notify_handle; 
// extern uint16_t sramout_data_handle;
// extern uint16_t sramout_notify_handle;  
// extern uint16_t al_data_handle; 
// extern uint16_t dl_data_handle; 
// extern uint16_t dataout_data_handle; 
// extern uint16_t dataout_notify_handle;
// extern uint16_t syscmd_data_handle;
// extern uint16_t count_status_data_handle;

/* --- Function Prototypes --- */

/**
 * @brief Triggers a GATT Read for AL counter.
 */
void al_read(int slot);

/**
 * @brief Triggers a GATT Read for the DL counter.
 */
void dl_read(int slot);

/**
 * @brief Triggers a GATT Read for Dataout.
 */
void dataout_read(int slot);

void count_status_read(int slot);

/**
 * @brief Packs 126-bit SIPO configuration and writes it to the Patch.
 */
void write_sipo(uint16_t s7, uint16_t s6, uint16_t s5, uint16_t s4, 
                uint16_t s3, uint16_t s2, uint16_t s1, uint16_t s0, int slot); 

/**
 * @brief Packs 36-bit DAC I2C data and writes it to the Patch.
 */
void write_dac(uint16_t d2, uint16_t d1, uint16_t d0, int slot); 

/**
 * @brief Writes system command to the patch.
 */
void write_sys_cmd(uint8_t command, int slot); 

/**
 * @brief Creates connection when device is found.
 */ 
void device_found(const bt_addr_le_t *addr, int8_t rssi, uint8_t type, struct net_buf_simple *ad);

#ifdef __cplusplus
}
#endif

#endif /* BLE_H */
```

## src/final_mb.h
```c
/**
 * @file final_mb.h
 * @author Archie Lee
 * @brief Header file for motherboard.
 * @details Defines includes, data buffers, devices, and global variables.
 * @version 1.0
 * @date 2026-02-03
 */

#ifndef FINAL_PATCH_H
#define FINAL_PATCH_H

/* Includes ------------------------------------------------------------------*/
#include <zephyr/kernel.h>
#include <zephyr/bluetooth/bluetooth.h>
#include <zephyr/bluetooth/gatt.h>
#include <zephyr/bluetooth/uuid.h>
#include <zephyr/logging/log.h>
#include <zephyr/device.h>
#include <zephyr/drivers/uart.h>
#include <zephyr/usb/usb_device.h>
#include <zephyr/sys/reboot.h>

#ifdef __cplusplus
extern "C" {
#endif

/* Number of Patches ------------------------------------------------------------------*/
#define MAX_PATCHES 16

/* Global Data Buffers ------------------------------------------------------------------*/
extern uint16_t data_deq_0; 
extern uint16_t data_deq_1; 
extern uint32_t al_counter; 
extern uint32_t dl_counter; 
extern struct sramout_ble_packet ble_sramout_packet;
extern uint16_t dac2, dac1, dac0; 
extern uint16_t sipo7, sipo6, sipo5, sipo4, sipo3, sipo2, sipo1, sipo0;

extern uint8_t done_wr_sipo; 
extern uint8_t done_wr_dac; 
extern uint16_t SRAM_rd_reset; 
extern uint16_t dlal_reset; 
extern uint16_t data_rd_reset;
extern uint16_t sipo_reset; 

// for status count 
// extern uint32_t status_count; 

// extern uint16_t status_data_0; 
// extern uint16_t status_data_1; 

// extern uint16_t status_data_2; 
// extern uint16_t status_data_3; 

// extern uint16_t status_data_4; 
// extern uint16_t status_data_5;

// extern uint16_t status_data_6; 
// extern uint16_t status_data_7; 

// extern uint16_t status_data_8; 
// extern uint16_t status_data_9;

// extern uint16_t status_data_10; 
// extern uint16_t status_data_11;

// extern uint16_t status_data_12; 
// extern uint16_t status_data_13;

// extern uint16_t status_data_14; 
// extern uint16_t status_data_15;

// extern uint16_t status_data_16; 
// extern uint16_t status_data_17;

// extern uint16_t status_data_18; 
// extern uint16_t status_data_19;


extern int board_address;

extern int connected_patches; 
extern int patch_num; 

/* UART  ------------------------------------------------------------------*/
extern const struct device *uart; 

/* BLE Variables ------------------------------------------------------------------*/
extern struct bt_conn *current_conn[MAX_PATCHES];
extern const struct bt_data ad[2]; 
extern struct bt_le_scan_param scan_param;

struct __packed sramout_ble_packet {
    uint16_t SRAM_out0;
    uint16_t SRAM_out1;
    uint16_t SRAM_out2;
    uint16_t SRAM_out3;
    uint16_t SRAM_out4;
    uint16_t SRAM_out5;
    uint16_t SRAM_out6;
    uint16_t SRAM_out7;
    uint16_t SRAM_out8;
    uint16_t SRAM_out9;  
};

// struct __packed dataout_ble_packet {
//     uint32_t dataout; 
//     uint64_t timestamp; 
// }; // need to change 

struct __packed dataout_ble_packet {
    uint64_t dataout   : 26; // Your ASIC pulse width (26 bits)
    uint64_t reserved  : 6;  // Padding to reach exactly 64 bits (8 bytes) 
    uint64_t timestamp : 32; // Lower 32 bits of RTC (30.5us precision)
}; 

struct __packed count_status_packet {
    uint32_t counts; 
    uint32_t curr_time; 
    struct dataout_ble_packet dt[1];
};

/* K_WORK  ------------------------------------------------------------------*/
struct command_work_t {
    struct k_work work;
    char payload[128];
};

extern struct command_work_t process_command_work;

#ifdef __cplusplus
}
#endif

#endif /* FINAL_MB_H */
```

## src/uart.c
```c
/**
 * @file uart.c
 * @author Archie Lee
 * @brief Handles USB over UART logic to communicate with PC GUI. 
 * @details Implements initializing UART, UART callback, and processing input UART.   
 * @version 1.0
 * @date 2026-02-03
 */

/* Includes ------------------------------------------------------------------*/
#include "final_mb.h"

// logging 
LOG_MODULE_DECLARE(final_mb, LOG_LEVEL_INF);

/* Variables  ------------------------------------------------------------------*/
static uint8_t rx_buffer[128]; 
int board_address = 1; 

/* UART Handle Functions ------------------------------------------------------------------*/
static void handle_sipo(char *buf) {
        // SIPO:s7,s6,...,s0
        int len = sscanf(buf + 5, "%hx,%hx,%hx,%hx,%hx,%hx,%hx,%hx", 
                           &sipo7, &sipo6, &sipo5, &sipo4, &sipo3, &sipo2, &sipo1, &sipo0);

        done_wr_sipo = 0; 
        // sramout_reset(); make patch reset when the sipo data arrives
        // sipo_reset(); make patch reset when the sipo data arrives  
        if (len == 8) {
                write_sipo(sipo7, sipo6, sipo5, sipo4, sipo3, sipo2, sipo1, sipo0, board_address); 
        }
        
}

static void handle_dac(char *buf) {
        // DAC:dac2,dac1,dac0
        int len = sscanf(buf + 4, "%hx,%hx,%hx", &dac2, &dac1, &dac0);

        done_wr_dac = 0; 
        // dac_reset(); make patch reset when the dac data arrives
        if (len == 3) {
                 write_dac(dac2, dac1, dac0, board_address); 
        }
        
} 

static void handle_patch_num(char *buf) {
        int len = sscanf(buf + 10, "%d", &patch_num);
        LOG_INF("number of patches: %d", patch_num); 
}

void start_counts(void) {
    for (int i = 0; i< patch_num; i++) {
        write_sys_cmd(9, i);
        k_msleep(10); 
    }
}

void stop_counts(char *buf) {
    int i = atoi(buf + 5); 
    if (i >= 0 && i < patch_num) {
        write_sys_cmd(8, i); 
        k_msleep(10); 
    } else { 
        LOG_INF("invalid patch number"); 
    }
}

void reset_mb(void) {
    sys_reboot(SYS_REBOOT_COLD); 
}

void reset_system(void) {
    for (int i = 0; i < patch_num; i++) {
        write_sys_cmd(10, i);
        k_msleep(10);
    }   
}

/* UART Process Function ------------------------------------------------------------------*/
void process_command(char *buf, const struct device *dev) {
        if (buf == NULL || buf[0] == '\0') return;

        switch(buf[0]) {
                case 'B': 
                        if (strncmp(buf, "B_ADDR:", 7) == 0) board_address = atoi(buf + 7); 
                        break; 
                case 'C':  
                        //if (strcmp(buf, "CLK_TOGG") == 0) clk_toggle(); // don't think this is needed
                        if (strcmp(buf, "COUNTSTATUS_RQST") == 0) count_status_read(board_address); 
                        else if (strcmp(buf, "CH_RST") == 0) write_sys_cmd(6, board_address); // needed
                        break; 
                case 'D': 
                        if (strncmp(buf, "DAC:", 4) == 0) handle_dac(buf); // make sure to call reset_dac() first
                        // else if (strcmp(buf, "DAC_RST") == 0) reset_dac();
                        else if (strcmp(buf, "DLAL_RST") == 0) write_sys_cmd(4, board_address); 
                        else if (strcmp(buf, "DLAL_RQST") == 0) dl_read(board_address); 
                        else if (strcmp(buf, "DATA_RD_RST") == 0) write_sys_cmd(5, board_address); // think more
                        break;
                case 'P': 
                        if (strncmp(buf, "PATCH_NUM:", 10) == 0) handle_patch_num(buf); 
                        break; 
                case 'R': 
                        if (strcmp(buf, "RST_GLOBAL") == 0) write_sys_cmd(7, board_address); 
                        else if (strcmp(buf, "RST_MB") == 0) reset_mb(); 
                        else if (strcmp(buf, "RST_SYS") == 0) reset_system();  
                        break;
                case 'S': 
                        if (strncmp(buf, "SIPO:", 5) == 0) handle_sipo(buf); // make sure to call reset_sipo() and reset_sramout() first 
                        else if (strncmp(buf, "STOPG", 5) == 0) stop_counts(buf); 
                        else if (strncmp(buf, "STARTG:", 7) == 0) start_counts();
                        // else if (strcmp(buf, "SIPO_RST") == 0) reset_sipo(); 
                        //else if (strcmp(buf, "SRAM_RD_RST") == 0) reset_sramout(); 
                        break;  
                default: 
                        LOG_WRN("Invalid GUI command"); 
                        break; 
        }
}

/* UART Callback Function ------------------------------------------------------------------*/
static void uart_cb(const struct device *dev, void *user_data)
{
    static int rx_ptr = 0;
    if (!uart_irq_update(dev)) return;

    if (uart_irq_rx_ready(dev)) {
        uint8_t byte;
        while (uart_fifo_read(dev, &byte, 1) > 0) {
            if (byte == '\n' || byte == '\r') {
                if (rx_ptr > 0){
                        rx_buffer[rx_ptr] = '\0'; // Terminate string
                        strncpy(process_command_work.payload, rx_buffer, sizeof(process_command_work.payload));
                        k_work_submit(&process_command_work.work);  
                } 
                rx_ptr = 0; // Reset for next command

            } else if (rx_ptr < (sizeof(rx_buffer) - 1)) {
                rx_buffer[rx_ptr++] = byte;
            }
        }
    }
}

/* Initialize UART Function ------------------------------------------------------------------*/
void initialize_uart(void) {
    /* Enable USB serial */ 
        int ret = usb_enable(NULL); 
        if (ret) {
                LOG_ERR("CDC ACM not ready\n");
                return;
        }
 
        if (!device_is_ready(uart)) {
                LOG_ERR("CDC ACM not ready\n");
                return;
        }

        int dtr = 0;  
        while (!dtr) {
               uart_line_ctrl_get(uart, UART_LINE_CTRL_DTR, &dtr); 
               k_msleep(10);
        }

        // set callback function
        uart_irq_callback_set(uart, uart_cb);

        // enable uart rx interrupt 
        uart_irq_rx_enable(uart);

}
```
